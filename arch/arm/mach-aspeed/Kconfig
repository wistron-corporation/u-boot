## arch/arm/mach-aspeed/Kconfig
```kconfig
if ARCH_ASPEED

config SYS_ARCH
	default "arm"

config SYS_SOC
	default "aspeed"

config SYS_TEXT_BASE
	default 0x00000000

config ASPEED_AST2500
	bool "Support Aspeed AST2500 SoC"
	depends on DM_RESET
	select CPU_ARM1176
	select SUPPORT_SPL
	help
	  The Aspeed AST2500 is a ARM-based SoC with arm1176 CPU.
	  It is used as Board Management Controller on many server boards,
	  which is enabled by support of LPC and eSPI peripherals.

config ASPEED_AST2600
	bool "Support Aspeed AST2600 SoC"
	depends on DM_RESET
	select SYS_ARCH_TIMER
	select CPU_V7A
	select CPU_V7_HAS_NONSEC
	select ARCH_SUPPORT_PSCI
	select SUPPORT_SPL
	select EXPERT
	help
	  The Aspeed AST2600 is a ARM-based SoC with Cortex-A7 CPU.
	  It is used as Board Management Controller on many server boards,
	  which is enabled by support of LPC and eSPI peripherals.

source "arch/arm/mach-aspeed/ast2500/Kconfig"

source "arch/arm/mach-aspeed/ast2600/Kconfig"

endif
```

## arch/powerpc/cpu/47x/Kconfig
```kconfig
menu "ppc4xx CPU"
	depends on 47x

config SYS_CPU
	default "47x"

choice
	prompt "Target select"
	optional

config SOC_IBM_FSP2
	bool "support fsp2"
	select PANIC_HANG
	select IBM_EMAC4
	select BOARD_EARLY_INIT_F
	select OF_LIBFDT
	select OF_BOARD_SETUP
	select CMD_FDT
	select UART750

endchoice

config SYS_PERIPHERAL_BASE
	bool

config SYS_EXT_SERIAL_CLOCK
	int "clock"
	default 20833333

config SDRAM_PPC4xx_IBM_DDR
	bool

config SDRAM_PPC4xx_IBM_DDR2
	bool

source "board/ibm/fsp2/Kconfig"

endmenu
```

## board/aspeed/ncsi_ast2600/Kconfig
```kconfig
if TARGET_NCSI_AST2600

config SYS_BOARD
	default "ncsi_ast2600"

config SYS_VENDOR
	default "aspeed"

config SYS_CONFIG_NAME
	string "board configuration name"
	default "ncsi_ast2600"

endif
```

## board/ibm/fsp2/Kconfig
```kconfig
if SOC_IBM_FSP2

config SYS_BOARD
	default "fsp2"

config SYS_VENDOR
	default "ibm"

config SYS_CONFIG_NAME
	default "ibm_fsp2"

endif
```

## configs/evb-ast2500-spl_defconfig
```kconfig
CONFIG_ARM=y
CONFIG_SYS_CONFIG_NAME="evb_ast2500_spl"
CONFIG_SPL_LDSCRIPT="board/aspeed/evb_ast2500/u-boot-spl.lds"
CONFIG_ARCH_ASPEED=y
CONFIG_SYS_TEXT_BASE=0x10000
CONFIG_ASPEED_AST2500=y
CONFIG_TARGET_EVB_AST2500=y
CONFIG_SPL_LIBCOMMON_SUPPORT=y
CONFIG_SPL_LIBGENERIC_SUPPORT=y
CONFIG_SYS_MALLOC_F_LEN=0x2000
CONFIG_SPL_SERIAL_SUPPORT=y
CONFIG_SPL=y
CONFIG_NR_DRAM_BANKS=1
CONFIG_USE_BOOTARGS=y
CONFIG_BOOTARGS="console=ttyS4,115200n8 root=/dev/ram rw"
CONFIG_PRE_CONSOLE_BUFFER=y
CONFIG_PRE_CON_BUF_ADDR=0x1e720000
# CONFIG_TPL_BANNER_PRINT is not set
CONFIG_SPL_RAM_SUPPORT=y
CONFIG_SPL_RAM_DEVICE=y
# CONFIG_AUTO_COMPLETE is not set
CONFIG_SYS_PROMPT="ast# "
CONFIG_CMD_CLK=y
CONFIG_CMD_GPIO=y
CONFIG_CMD_I2C=y
CONFIG_CMD_MMC=y
CONFIG_CMD_SF=y
CONFIG_CMD_DHCP=y
CONFIG_CMD_MII=y
CONFIG_CMD_PING=y
# CONFIG_CMD_NETTEST is not set
CONFIG_DEFAULT_DEVICE_TREE="ast2500-evb"
CONFIG_ENV_IS_IN_SPI_FLASH=y
CONFIG_USE_ENV_SPI_BUS=y
CONFIG_ENV_SPI_BUS=0
CONFIG_USE_ENV_SPI_CS=y
CONFIG_ENV_SPI_CS=0
CONFIG_USE_ENV_SPI_MAX_HZ=y
CONFIG_ENV_SPI_MAX_HZ=100000000
CONFIG_NET_RANDOM_ETHADDR=y
CONFIG_REGMAP=y
CONFIG_CLK=y
CONFIG_DM_GPIO=y
CONFIG_ASPEED_GPIO=y
CONFIG_DM_I2C=y
CONFIG_SYS_I2C_ASPEED=y
CONFIG_MISC=y
CONFIG_DM_MMC=y
# CONFIG_MMC_HW_PARTITIONING is not set
CONFIG_MMC_SDHCI=y
CONFIG_MMC_SDHCI_ASPEED=y
CONFIG_DM_SPI_FLASH=y
CONFIG_SPI_FLASH=y
CONFIG_SPI_FLASH_MACRONIX=y
CONFIG_SPI_FLASH_SPANSION=y
CONFIG_SPI_FLASH_WINBOND=y
CONFIG_PHY_REALTEK=y
CONFIG_DM_ETH=y
CONFIG_FTGMAC100=y
CONFIG_PHY=y
CONFIG_PINCTRL=y
CONFIG_RAM=y
CONFIG_DM_RESET=y
# CONFIG_SPECIFY_CONSOLE_INDEX is not set
CONFIG_SYS_NS16550=y
CONFIG_SPI=y
CONFIG_DM_SPI=y
CONFIG_SYSRESET=y
CONFIG_TIMER=y
CONFIG_WDT=y
```

## configs/evb-ast2600_defconfig
```kconfig
CONFIG_ARM=y
CONFIG_ARCH_ASPEED=y
CONFIG_SYS_TEXT_BASE=0x0
CONFIG_ASPEED_AST2600=y
CONFIG_TARGET_EVB_AST2600=y
CONFIG_SYS_MALLOC_F_LEN=0x2000
CONFIG_NR_DRAM_BANKS=1
CONFIG_USE_BOOTARGS=y
CONFIG_BOOTARGS="console=ttyS4,115200n8 root=/dev/ram rw"
CONFIG_PRE_CONSOLE_BUFFER=y
CONFIG_PRE_CON_BUF_ADDR=0x10000000
CONFIG_DISPLAY_BOARDINFO_LATE=y
# CONFIG_AUTO_COMPLETE is not set
CONFIG_CMD_DHCP=y
CONFIG_CMD_MII=y
CONFIG_CMD_PING=y
CONFIG_DEFAULT_DEVICE_TREE="ast2600-evb"
CONFIG_REGMAP=y
CONFIG_CLK=y
# CONFIG_MMC is not set
# CONFIG_NETDEVICES is not set
CONFIG_PHY=y
CONFIG_PINCTRL=y
CONFIG_DM_RESET=y
CONFIG_DM_SERIAL=y
CONFIG_SYS_NS16550=y
CONFIG_SYSRESET=y
CONFIG_WDT=y
# CONFIG_GENERATE_SMBIOS_TABLE is not set
```

## configs/fsp2_defconfig
```kconfig
CONFIG_PPC=y
CONFIG_47x=y
CONFIG_SOC_IBM_FSP2=y
CONFIG_HUSH_PARSER=y
CONFIG_CMD_DHCP=y
CONFIG_CMD_MII=y
CONFIG_CMD_PING=y
CONFIG_CMD_DIAG=y
# CONFIG_PARTITIONS is not set
# CONFIG_NET_TFTP_VARS is not set
CONFIG_NETDEVICES=y
# CONFIG_PCI is not set
CONFIG_SYS_NS16550=y
```

## drivers/ram/aspeed/Kconfig
```kconfig
choice
	prompt "DDR4 target data rate"
	default ASPEED_DDR4_1600

config ASPEED_DDR4_800
        bool "DDR4 targets at 800Mbps"
        depends on DM && OF_CONTROL && ARCH_ASPEED
        select RAM
        select SPL_RAM if SPL
        help
                select DDR4 target data rate at 800M

config ASPEED_DDR4_1600
        bool "DDR4 targets at 1600Mbps"
        depends on DM && OF_CONTROL && ARCH_ASPEED
        select RAM
        select SPL_RAM if SPL
        help
                select DDR4 target data rate at 1600M
endchoice

config ASPEED_DDR4_DUALX8
        bool "dual X8 DDR4 die"
        depends on DM && OF_CONTROL && ARCH_ASPEED
        select RAM
        select SPL_RAM if SPL
        default n
        help
                select dual X8 DDR4 die
```
